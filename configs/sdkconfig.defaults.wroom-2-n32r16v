## configs/sdkconfig.defaults.wroom-2-n32r16v
```kconfig
# sdkconfig.defaults template: ESP32-S3-WROOM-2 N32R16V
# Flash : 32 MB Octal SPI (8-line)
# PSRAM : 16 MB Octal SPI (8-line)
# V_SPI : 1.8 V
# Used by configure.bat when BOARD_MODULE_WROOM_2_N32R16V is selected
# (default; matches the dev kit).
# See HARDWARE_MODULE_MIGRATION.md for the full comparison.

CONFIG_IDF_TARGET="esp32s3"

# Flash (Octal SPI, 32 MB)
CONFIG_ESPTOOLPY_FLASHSIZE_32MB=y
CONFIG_ESPTOOLPY_OCT_FLASH=y
CONFIG_ESPTOOLPY_FLASHMODE_DIO=y

# PSRAM (Octal SPI, 16 MB)
CONFIG_SPIRAM=y
CONFIG_SPIRAM_MODE_OCT=y
CONFIG_SPIRAM_SPEED_80M=y
CONFIG_SPIRAM_USE_CAPS_ALLOC=y

# Partition table (single factory, no OTA by default)
CONFIG_PARTITION_TABLE_CUSTOM=y
CONFIG_PARTITION_TABLE_CUSTOM_FILENAME="partitions.csv"
CONFIG_PARTITION_TABLE_FILENAME="partitions.csv"

# File system
CONFIG_FATFS_LFN_STACK=y
CONFIG_FATFS_MAX_LFN=255
CONFIG_FATFS_CODEPAGE=437

# Bus config
CONFIG_SPI_MASTER_IN_IRAM=y
CONFIG_I2C_ISR_IRAM_SAFE=y

# CPU
CONFIG_ESP_DEFAULT_CPU_FREQ_MHZ_240=y
CONFIG_ESP_MAIN_TASK_STACK_SIZE=8192

# Logging
CONFIG_LOG_DEFAULT_LEVEL_INFO=y
CONFIG_LOG_MAXIMUM_LEVEL_DEBUG=y

# Enable ESP-ADF (audio_player.cpp uses real audio_pipeline)
CONFIG_USE_ESP_ADF=y

# Enable u8g2 OLED (display.cpp uses real u8g2 rendering)
CONFIG_USE_U8G2=y
```

## main/Kconfig.projbuild
```kconfig
menu "Target Module Selection"

choice BOARD_MODULE
    prompt "Target ESP32-S3 Module"
    default BOARD_MODULE_WROOM_2_N32R16V
    help
        Select the ESP32-S3 module variant for this build.
        This option drives which sdkconfig defaults template configure.bat uses.

        - WROOM-1 N16R8:    16 MB Flash (Quad) +  8 MB PSRAM (Octal), 3.3 V SPI, supports OTA
        - WROOM-2 N32R16V:  32 MB Flash (Octal) + 16 MB PSRAM (Octal), 1.8 V SPI

        See HARDWARE_MODULE_MIGRATION.md for full details.

    config BOARD_MODULE_WROOM_1_N16R8
        bool "ESP32-S3-WROOM-1 N16R8 (16 MB Flash + 8 MB PSRAM, 3.3 V SPI) - PRODUCTION"
        help
            Production target. 16 MB Quad SPI flash + 8 MB Octal PSRAM.
            Uses partitions_ota.csv (each app slot = 2 MB).
            GPIO33/34 are free (not used by SPI).
            PCB must NOT have an external 1.8 V LDO (SPI is 3.3 V).

    config BOARD_MODULE_WROOM_2_N32R16V
        bool "ESP32-S3-WROOM-2 N32R16V (32 MB Flash + 16 MB PSRAM, 1.8 V SPI) - DEV KIT"
        help
            Dev kit module (default). 32 MB Octal SPI flash + 16 MB Octal PSRAM.
            Uses partitions.csv (single 3 MB factory app, no OTA).

endchoice

config BOARD_MODULE_NAME
    string
    default "wroom-1-n16r8"   if BOARD_MODULE_WROOM_1_N16R8
    default "wroom-2-n32r16v" if BOARD_MODULE_WROOM_2_N32R16V
    help
        Derived module identifier used by configure.bat to pick the matching
        sdkconfig.defaults template under configs/.

config BOARD_SPI_VOLTAGE_1V8
    bool
    default y if BOARD_MODULE_WROOM_2_N32R16V
    default n
    help
        SPI voltage on the module's VDD_SPI pin.
        1.8 V for WROOM-2; 3.3 V for WROOM-1 N16R8.

config BOARD_HAS_OCTAL_FLASH
    bool
    default y if BOARD_MODULE_WROOM_2_N32R16V
    default n
    help
        Whether the on-board flash uses Octal SPI (8 lines).
        Drives CONFIG_ESPTOOLPY_OCT_FLASH.

config BOARD_SUPPORTS_OTA
    bool
    default y if BOARD_MODULE_WROOM_1_N16R8
    default n
    help
        Whether the partition table supports OTA firmware updates.
        N16R8 has 16 MB flash (enough for two app slots); WROOM-2 dev board
        uses single factory partition (no OTA by default).

config BOARD_PARTITION_TABLE
    string
    default "partitions_ota.csv" if BOARD_MODULE_WROOM_1_N16R8
    default "partitions.csv"      if BOARD_MODULE_WROOM_2_N32R16V
    help
        Partition table filename (must exist in project root).

config BOARD_FREE_GPIO33_34
    bool
    default y if BOARD_MODULE_WROOM_1_N16R8
    default n
    help
        On WROOM-1 Quad SPI flash modules, GPIO33 and GPIO34 are not used by SPI
        and are available for application use.

config USE_ESP_ADF
    bool "Enable ESP-ADF (real audio playback)"
    default y
    help
        Enable ESP-ADF audio pipeline (audio_pipeline / mp3_decoder / i2s_stream).
        When disabled, audio_player.cpp falls back to a stub that only logs.
        Requires ADF_PATH environment variable pointing to your ESP-ADF install
        (e.g. D:\esp\esp-adf).

config USE_U8G2
    bool "Enable u8g2 OLED display library"
    default y
    help
        Enable u8g2 library for SSD1306/SSD1315 OLED display via I2C.
        When disabled, display output goes to serial log only.
        Requires u8g2 and u8g2_esp32_hal components (included in components/).

endmenu
```
