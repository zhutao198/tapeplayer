## diag/lcd_sweep/sdkconfig.defaults
```kconfig
# LCD SPI 频率扫描诊断固件 (TapeBook 专用, 不影响主固件)
CONFIG_IDF_TARGET="esp32s3"

# 与主板烧录参数一致
CONFIG_ESPTOOLPY_FLASHMODE_DIO=y
CONFIG_ESPTOOLPY_FLASHFREQ_80M=y
CONFIG_ESPTOOLPY_FLASHSIZE_16MB=y
CONFIG_ESPTOOLPY_FLASHSIZE_16MB=y
CONFIG_ESPTOOLPY_BAUD_921600B=y

# 复用主工程分区表(仅构建期用; 诊断固件只烧 0x10000 app 分区)
CONFIG_PARTITION_TABLE_CUSTOM=y
CONFIG_PARTITION_TABLE_CUSTOM_FILENAME="partitions_ota.csv"
CONFIG_PARTITION_TABLE_OFFSET=0x8000

# 诊断日志开足, 其余默认
CONFIG_LOG_DEFAULT_LEVEL_INFO=y
```
